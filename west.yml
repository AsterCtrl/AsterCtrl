## west.yml
```yaml
# SPDX-License-Identifier: Apache-2.0

manifest:
  version: "1.2"

  remotes:
    - name: zephyrproject-rtos
      url-base: https://github.com/zephyrproject-rtos
    - name: asterctrl
      url-base: https://github.com/AsterCtrl

  projects:
    - name: zephyr
      remote: zephyrproject-rtos
      # Zephyr v4.4.0, peeled to the commit used for all release builds.
      revision: 684c9e8f32e4373a21098559f748f06915f950c9
      import: true

    - name: asterctrl-boards
      remote: asterctrl
      path: asterctrl-boards
      revision: fbf4f75f0d7cd306e237f5baf06a0978a14a98c3

  self:
    path: asterctrl
```

## zephyr/Kconfig
```kconfig
menuconfig ASTERCTRL
  bool "AsterCtrl runtime"
  default y
  help
    Enable the native AsterCtrl runtime and generated static composition.

if ASTERCTRL

config ASTERCTRL_MAX_MODULES
  int "Maximum Module count"
  range 1 128
  default 16

config ASTERCTRL_MAX_CHANNELS
  int "Maximum Channel count"
  range 1 512
  default 32

config ASTERCTRL_MAX_SUBSCRIBERS_PER_CHANNEL
  int "Maximum subscriber count per Channel"
  range 1 512
  default 16
  help
    Capacity of each generated local Channel subscriber table. Normally
    generated from all declared subscriber ports, including optional ports.

config ASTERCTRL_MAX_RPC_SERVICES
  int "Maximum RPC service count"
  range 1 128
  default 16

config ASTERCTRL_EXECUTOR_QUEUE_DEPTH
  int "Default Executor queue depth"
  range 1 256
  default 16

config ASTERCTRL_MAX_MESSAGE_BYTES
  int "Maximum encoded Channel or RPC message size"
  range 1 65535
  default 256
  help
    Fixed capacity shared by the generated local Channel and RPC registries.
    Normally generated by aster from bounded message routes.

config ASTERCTRL_ARENA_BYTES
  int "Runtime fixed arena size"
  range 1 1048576
  default 4096

config ASTERCTRL_MAX_HARDWARE_CAPABILITIES
  int "Maximum Hardware capability count"
  range 1 256
  default 16
  help
    Capacity of the generated HardwareManager registry. Normally generated by
    aster from the selected Hardware Profile.

config ASTERCTRL_ROUTE_COUNT
  int "Resolved route-table capacity"
  range 1 65535
  default 1
  help
    Resolved route-table capacity. Normally generated by aster.

config ASTERCTRL_STACK_BYTES
  int "Resolved aggregate Module stack budget"
  range 1024 1048576
  default 4096
  help
    Resolved aggregate Module stack budget. Normally generated by aster.

config ASTERCTRL_CAN
  bool "AsterCtrl CAN Transport Adapter"
  depends on CAN
  help
    Enable the Zephyr CAN device Adapter. Received frames cross from the CAN
    interrupt callback into thread context through a bounded message queue.

config ASTERCTRL_CAN_RX_QUEUE_DEPTH
  int "CAN receive handoff queue depth"
  range 1 256
  default 16
  depends on ASTERCTRL_CAN

config ASTERCTRL_CAN_TX_QUEUE_DEPTH
  int "CAN transmit queue depth"
  range 1 256
  default 16
  depends on ASTERCTRL_CAN
  help
    Fixed-capacity FIFO in front of the CAN controller. AsterCtrl submits only
    one frame at a time so fragmented frames with equal identifiers retain
    their order even when a controller provides multiple transmit mailboxes.

config ASTERCTRL_USB_CDC_ACM
  bool "AsterCtrl USB CDC ACM Transport Adapter"
  depends on USB_DEVICE_STACK_NEXT && SERIAL

config ASTERCTRL_USB_VID
  hex "Resolved USB Vendor ID"
  range 0x0001 0xFFFF
  default 0x1209
  depends on ASTERCTRL_USB_CDC_ACM
  help
    Product-owned USB Vendor ID emitted from the Deployment Graph.

config ASTERCTRL_USB_PID
  hex "Resolved USB Product ID"
  range 0x0001 0xFFFF
  default 0x0001
  depends on ASTERCTRL_USB_CDC_ACM
  help
    Product-owned USB Product ID emitted from the Deployment Graph.

endif
```
